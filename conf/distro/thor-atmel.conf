## conf/distro/thor-atmel.conf
```bitbake
DISTRO = "thor-atmel"
DISTRO_NAME = "Thor (Yocto Project Thor Distro)"
#DISTRO_VERSION = "3.4+snapshot-${METADATA_REVISION}"
DISTRO_VERSION = "4.0.13"
DISTRO_CODENAME = "kirkstone"
SDK_VENDOR = "-thorsdk"
SDK_VERSION = "${@d.getVar('DISTRO_VERSION').replace('snapshot-${METADATA_REVISION}', 'snapshot')}"
SDK_VERSION[vardepvalue] = "${SDK_VERSION}"

MAINTAINER = "Thor <roy@thor.engineering>"

TARGET_VENDOR = "-thor"

LOCALCONF_VERSION = "2"

# Override these in poky based distros
POKY_DEFAULT_DISTRO_FEATURES = "largefile multiarch"
POKY_DEFAULT_EXTRA_RDEPENDS = "packagegroup-core-boot"
POKY_DEFAULT_EXTRA_RRECOMMENDS = "kernel-module-af-packet"

DISTRO_FEATURES ?= "${DISTRO_FEATURES_DEFAULT} ${POKY_DEFAULT_DISTRO_FEATURES}"

PREFERRED_VERSION_linux-yocto ?= "5.15%"
PREFERRED_VERSION_linux-yocto-rt ?= "5.15%"

SDK_NAME = "${DISTRO}-${TCLIBC}-${SDKMACHINE}-${IMAGE_BASENAME}-${TUNE_PKGARCH}-${MACHINE}"
SDKPATHINSTALL = "/opt/${DISTRO}/${SDK_VERSION}"

DISTRO_EXTRA_RDEPENDS += "${POKY_DEFAULT_EXTRA_RDEPENDS}"
DISTRO_EXTRA_RRECOMMENDS += "${POKY_DEFAULT_EXTRA_RRECOMMENDS}"

TCLIBCAPPEND = ""

SANITY_TESTED_DISTROS ?= " \
            poky-3.4 \n \
            ubuntu-20.04 \n \
            ubuntu-22.04 \n \
            ubuntu-24.04 \n \
            fedora-37 \n \
            debian-11 \n \
            "
# add poky sanity bbclass
INHERIT += "poky-sanity"

# QA check settings - a little stricter than the OE-Core defaults
# (none currently necessary as we now match OE-Core)
#WARN_TO_ERROR_QA = "X"
#WARN_QA_remove = "${WARN_TO_ERROR_QA}"
#ERROR_QA_append = " ${WARN_TO_ERROR_QA}"

require conf/distro/include/no-static-libs.inc
require conf/distro/include/yocto-uninative.inc
require conf/distro/include/security_flags.inc
INHERIT += "uninative"

BB_SIGNATURE_HANDLER ?= "OEEquivHash"
BB_HASHSERVE ??= "auto"

# Make sure unwanted features are REMOVED from the distro!
DISTRO_FEATURES:remove ?= "opengl wayland vulkan x11 3g nfc pulseaudio zeroconf ofono bluetooth"

DISTRO_FEATURES += "pam ppp"

# icu is needed to get egt
PACKAGECONFIG_DISTRO:pn-egt ?= "icu openssl freetype fontconfig"

EXTRA_OECONF:remove = "${DISABLE_STATIC}"
PREFERRED_VERSION_swig = "3.0.8"

VIRTUAL-RUNTIME_syslog = "busybox-syslog"

HOSTTOOLS:append = " xxd"

PACKAGECONFIG:remove:pn-rng-tools = "libjitterentropy"
```

## conf/layer.conf
```bitbake
# We have a conf and classes directory, add to BBPATH
BBPATH .= ":${LAYERDIR}"

# We have recipes-* directories, add to BBFILES
BBFILES += "${LAYERDIR}/recipes-*/*.bb \
	${LAYERDIR}/recipes-*/*/*.bbappend"

BBFILE_COLLECTIONS += "thornxt"
BBFILE_PATTERN_thornxt = "^${LAYERDIR}/"
BBFILE_PRIORITY_thornxt = "10"

# Don't install the kernel and dts into the rootfs.
MACHINE_ESSENTIAL_EXTRA_RDEPENDS:remove = "dt-overlay-mchp"

DISTRO_FEATURES:remove = "zeroconf ofono bluetooth 3g nfc"

LAYERSERIES_COMPAT_thornxt = "kirkstone"

# NOTE
# we set priority to same as the atmel layer
```

## recipes-kernel/linux/patches/Kconfig.patch
```kconfig
--- a/sound/soc/atmel/Kconfig	2016-08-06 00:13:52.275443000 +0200
+++ b/sound/soc/atmel/Kconfig	2016-08-14 13:14:34.470999547 +0200
@@ -45,6 +45,17 @@
 	  Say Y if you want to add support for Atmel ASoC driver for boards using
 	  WM8904 codec.
 
+config SND_ATMEL_SOC_SSM2518
+	tristate "Atmel ASoC driver for boards using SSM2518 codec"
+	depends on ARCH_AT91 || COMPILE_TEST
+	depends on ATMEL_SSC && SND_ATMEL_SOC && I2C
+	select SND_ATMEL_SOC_SSC
+	select SND_ATMEL_SOC_DMA
+	select SND_SOC_SSM2518
+	help
+	  Say Y if you want to add support for Atmel ASoC driver for boards using
+	  SSM2518 codec.
+
 config SND_AT91_SOC_SAM9X5_WM8731
 	tristate "SoC Audio support for WM8731-based at91sam9x5 board"
 	depends on ARCH_AT91 || COMPILE_TEST
```
